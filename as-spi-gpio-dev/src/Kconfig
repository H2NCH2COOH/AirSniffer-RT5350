## as-spi-gpio-dev/src/Kconfig
```kconfig
config AS_SPI_GPIO_DEV
	tristate "AirSniffer GPIO-based SPI device"
	depends on GENERIC_GPIO
	select SPI_GPIO
```

## as-spi-gpio/src/Kconfig
```kconfig
config AS_SPI_GPIO
	tristate "AirSniffer GPIO-based SPI driver"
	depends on GENERIC_GPIO
	select SPI_GPIO
	help
	  Used as inlined(fast) version of spi-gpio driver
```
